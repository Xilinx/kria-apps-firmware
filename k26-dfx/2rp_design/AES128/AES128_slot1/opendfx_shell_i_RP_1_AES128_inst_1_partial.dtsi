
/*
 * CAUTION: This file is automatically generated by Xilinx.
 * Version: XSCT 2022.1
 * Today is: Mon Feb 14 22:42:09 2022
 */

/dts-v1/;
/plugin/;
/ {
	fragment@0 {
		target = <&fpga_PR1>;
    	__overlay__ {
		firmware-name = "opendfx_shell_i_RP_1_AES128_inst_0_partial.bit.bin";
		partial-fpga-config ;
		};
	};


};
